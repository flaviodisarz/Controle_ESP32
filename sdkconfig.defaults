## sdkconfig.defaults
```kconfig
CONFIG_BT_ENABLED=y
CONFIG_BT_BLUEDROID_ENABLED=y
CONFIG_BT_BLE_ENABLED=y
CONFIG_BT_BLE_50_FEATURES_SUPPORTED=y
# se existir no menuconfig/IDF:
CONFIG_BT_BLE_42_FEATURES_SUPPORTED=y
```
